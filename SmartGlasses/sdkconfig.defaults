## SmartGlasses/sdkconfig.defaults
```kconfig
# ==== Chip Target ====
CONFIG_IDF_TARGET="esp32"

# Bluetooth base settings
CONFIG_BT_ENABLED=y
CONFIG_BT_CLASSIC_ENABLED=y
CONFIG_BT_SPP_ENABLED=y
CONFIG_BT_BLE_ENABLED=n

# Bluedroid stack
CONFIG_BT_BLUEDROID_ENABLED=y
CONFIG_BT_BLUEDROID_BTSTACK_ON_BT_CTRL=y
CONFIG_BT_BLUEDROID_MODE_BR_EDR=y
CONFIG_BT_BLUEDROID_MODE_BLE=n

# Classic BT (SPP)
CONFIG_BT_SPP_ENABLED=y
CONFIG_BT_SPP_INITIATOR_ROLE_ENABLED=y
CONFIG_BT_SPP_ACCEPTOR_ROLE_ENABLED=y

# Memória otimizada pra BR/EDR
CONFIG_BT_ACL_CONNECTIONS=2
CONFIG_BT_ALLOCATION_FROM_SPIRAM_FIRST=y

# Opcional: desativa BLE e BLE Mesh (economia de RAM)
CONFIG_BT_BLE_ENABLED=n
CONFIG_BT_MESH=n


# ==== Wi-Fi desativado ====
CONFIG_ESP_WIFI_ENABLED=n
CONFIG_ESP32_WIFI_STATIC_RX_BUFFER_NUM=0
CONFIG_ESP32_WIFI_DYNAMIC_RX_BUFFER_NUM=0
CONFIG_ESP32_WIFI_DYNAMIC_TX_BUFFER_NUM=0
CONFIG_ESP32_WIFI_TX_BA_WIN=6
CONFIG_ESP32_WIFI_AMPDU_TX_ENABLED=n
CONFIG_ESP32_WIFI_AMPDU_RX_ENABLED=n

# ==== I2S para INMP441 ====
CONFIG_I2S_ENABLE=y
CONFIG_I2S_STD_ENABLE=y
CONFIG_I2S_SUPPORT_LEGACY_API=y

# ==== FreeRTOS & Logging ====
CONFIG_LOG_DEFAULT_LEVEL_INFO=y
CONFIG_LOG_DEFAULT_LEVEL=3

# ==== Redução de tamanho final ====
CONFIG_ESP_SYSTEM_PANIC_PRINT_REBOOT=y
CONFIG_COMPILER_OPTIMIZATION_SIZE=y

# ==== Heap (opcionalmente reduzir logs BT) ====
CONFIG_BT_LOG_HCI_TRACE_LEVEL_NONE=y


CONFIG_PARTITION_TABLE_CUSTOM=n
CONFIG_PARTITION_TABLE_TYPE_2_1024K_1024K=y
```
